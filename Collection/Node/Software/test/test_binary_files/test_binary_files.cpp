/*Main.

This file test the binary output files.

This file is a part of the Wireless Sensor Network project.
(c) Copyright 2020 Jacob Larkin and Adriann Liceralde
*/

#include <Arduino.h>

#include <unity.h>

#include "debug_utils.h"
#include "CO2_sensor_controller.h"
#include "clock_controller.h"
#include "sdcard_controller.h"
#include "data_utils.h"
#include "communication_controller.h"


ClockController clock(ClockModes::FAKE_FAST);
CO2SensorController CO2Sensor(CO2SensorModes::FAKE_CONSTANT);
SDCardController sdCard(SDCardModes::NONE);
CommunicationController communication(CommunicationModes::NONE);


uint8_t hour = 0;

//generated by generate_hourly_checksums.py
uint32_t hourly_checksums_const[24] = {0XF94378F9, 0X5BC3D474, 0X9B52CF04, 0X3ADBCB14,
                                       0XC76BCCC8, 0X9BDDE2F4, 0X2C008459, 0XCE24B247,
                                       0X9D9AEF48, 0X316CEAD4, 0XAF20B54C, 0XD7B9ECE4,
                                       0XA9E986EA, 0X1950F2B0, 0X57DDD807, 0X90C5F1C1,
                                       0X85C14263, 0XE670D55C, 0X5A081412, 0X6EFF79DA,
                                       0X16F9BAA4, 0XAD44041E, 0X49FC9080, 0X75BC68D9};


void test_hourly_checksum(void) {
    TEST_ASSERT_EQUAL_HEX32(hourly_checksums_const[hour], sdCard.checksum);
}


void setup() {
    delay(2000);
    UNITY_BEGIN();
    

    clock.begin();
    CO2Sensor.begin();
    sdCard.begin();
    communication.begin();
    
    CO2Sensor.CONSTANT_VALUE = 0xA1D5762F;
    
    clock.setTime(DateTime(2020, 1, 1, 0, 0, 0).unixtime());
}


void loop() {
    while(!clock.isNextSecond());

    uint32_t gasData = CO2Sensor.collectData();
    sdCard.writeDataPoint(clock.unixtime(), gasData);


    if (clock.isNextHour()) {
        RUN_TEST(test_hourly_checksum);
        sdCard.createNewFile(clock.currentFilename());
        hour++;
    }

    if (clock.isNextDay()) {
        communication.sendFiles();
        UNITY_END();
    }
}